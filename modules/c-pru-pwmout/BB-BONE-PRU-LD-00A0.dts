/dts-v1/;

/ {
	compatible = "ti,beaglebone", "ti,beaglebone-black";
	part-number = "BB-BONE-PRU-LD";
	version = "00A0";
	exclusive-use = "P9.24", "P9.25", "P9.27", "P9.28", "P9.29", "P9.30", "P9.31",
					"P8.27", "P8.28", "P8.29", "P8.30", "P8.39", "P8.40", "P8.41", "P8.42","P8.43","P8.44","P8.45","P8.46", "pru0, pru1";

	fragment@0 {
		target = <0xdeadbeef>;

		__overlay__ {

			pinmux_pru_pru_pins {
				pinctrl-single,pins = <
					/* Page 754 of am335x TRM */
					/* PRU Pins */
					0x184 0x26	/* P9-24 uart1_txd, pr1_pru0_pru_r31_16  	*/
					0x1AC 0x26	/* P9-25 mcasp0_ahclkx, pr1_pru0_pru_r31_7  */
					0x1A4 0x26	/* P9-27 mcasp0_fsr, pr1_pru0_pru_r31_5 	*/
					0x19C 0x26	/* P9-28 mcasp0_ahclkr, pr1_pru0_pru_r31_3 	*/
					0x194 0x26	/* P9-29 mcasp0_fsx, pr1_pru0_pru_r31_1		*/
					0x198 0x26	/* P9-30 mcasp0_axr0, pr1_pru0_pru_r31_2	*/
					0x190 0x26	/* P9-31 mcasp0_aclkx, pr1_pru0_pru_r31_0	*/
						
					0x0E0 0x5	/* P8-27 lcd_vsync, pr1_pru1_pru_r30_8		*/
					0x0E8 0x5	/* P8-28 lcd_pclk, pr1_pru1_pru_r30_10		*/
					0x0E4 0x5	/* P8-29 lcd_hsync, pr1_pru1_pru_r30_9		*/
					0x0EC 0x5	/* P8-30 lcd_ac_bias_en, pr1_pru1_pru_r30_11*/
					0x0B8 0x5	/* P8-39 lcd_data6, pr1_pru1_pru_r30_6		*/
					0x0BC 0x5	/* P8-40 lcd_data7, pr1_pru1_pru_r30_7		*/
					0x0B0 0x5	/* P8-41 lcd_data4, pr1_pru1_pru_r30_4		*/
					0x0B4 0x5	/* P8-42 lcd_data5, pr1_pru1_pru_r30_5		*/
					0x0A8 0x5	/* P8-43 lcd_data2, pr1_pru1_pru_r30_2		*/
					0x0AC 0x5	/* P8-44 lcd_data3, pr1_pru1_pru_r30_3		*/
					0x0A0 0x5	/* P8-45 lcd_data0, pr1_pru1_pru_r30_0		*/
					0x0A4 0x5	/* P8-46 lcd_data1, pr1_pru1_pru_r30_1		*/	
				>;
				linux,phandle = <0x1>;
				phandle = <0x1>;
			};
		};
	};

	fragment@2 {
		target = <0xdeadbeef>;

		__overlay__ {
			status = "okay";
			pinctrl-names = "default";
			pinctrl-0 = <0x1>;
		};
	};

	__symbols__ {
		pru_gpio_pins = "/fragment@0/__overlay__/pinmux_pru_gpio_pins";
		pru_pru_pins = "/fragment@0/__overlay__/pinmux_pru_pru_pins";
	};

	__fixups__ {
		am33xx_pinmux = "/fragment@0:target:0";
		pruss = "/fragment@2:target:0";
	};

	__local_fixups__ {
		fixup = "/fragment@2/__overlay__:pinctrl-0:0";
	};
};
